## examples/esp_iris_ota/main/Kconfig.projbuild
```kconfig
menu "ESP-Iris OTA example"

config ESP_IRIS_OTA_EXAMPLE_RECOVERY
    bool "Build the factory recovery image"
    default n
    select ESP_IRIS_OTA
    help
        Build the image installed in the factory partition. The recovery image
        stays independent of normal A/B slots and is identified as recovery by
        its USB product string.

config ESP_IRIS_OTA_EXAMPLE_DIRECT_APPLICATION
    bool "Build a normal application with the OTA writer"
    default n
    depends on !ESP_IRIS_OTA_EXAMPLE_RECOVERY && !ESP_IRIS_OTA_DEFAULT_VIA_RECOVERY
    select ESP_IRIS_OTA
    help
        Builds the alternative direct-OTA profile. The normal application
        receives and writes the image itself, so the Gateway must use
        --execution-mode application. Leave this disabled for the smaller
        recovery-first A/B profiles.

config ESP_IRIS_OTA_EXAMPLE_AUTO_ACCEPT
    bool "Automatically accept a pending OTA image"
    default y
    depends on !ESP_IRIS_OTA_EXAMPLE_RECOVERY
    help
        Mark a pending image healthy after services have run for the configured
        delay. Disable this to exercise bootloader rollback or to accept the
        image explicitly through RPC service 0x1200, method 2.

config ESP_IRIS_OTA_EXAMPLE_ACCEPT_DELAY_MS
    int "Automatic acceptance delay (milliseconds)"
    range 1000 30000
    default 3000
    depends on ESP_IRIS_OTA_EXAMPLE_AUTO_ACCEPT && !ESP_IRIS_OTA_EXAMPLE_RECOVERY

endmenu
```

## examples/esp_iris_tcp_pairing/sdkconfig.defaults
```kconfig
CONFIG_IDF_TARGET="esp32s31"
CONFIG_IDF_EXPERIMENTAL_FEATURES=y
CONFIG_COMPILER_OPTIMIZATION_PERF=y
CONFIG_ESPTOOLPY_FLASHSIZE_2MB=y
CONFIG_ESP_CONSOLE_UART_DEFAULT=y
CONFIG_ESP_CONSOLE_SECONDARY_USB_SERIAL_JTAG=y

CONFIG_ESP_IRIS_TRANSPORT_TCP=y
CONFIG_ESP_IRIS_TCP_PAIRING=y
CONFIG_ESP_IRIS_TCP_PORT=19772
CONFIG_ESP_IRIS_AUTH_FAILURE_DELAY_MS=500

# Credentials and the initial pairing token deliberately have empty defaults.
CONFIG_ESP_IRIS_EXAMPLE_WIFI_SSID=""
CONFIG_ESP_IRIS_EXAMPLE_WIFI_PASSWORD=""
CONFIG_ESP_IRIS_EXAMPLE_PAIRING_TOKEN=""
```

## examples/esp_iris_tcp_wifi/main/Kconfig.projbuild
```kconfig
menu "ESP-Iris TCP Wi-Fi example"

config ESP_IRIS_EXAMPLE_WIFI_SSID
    string "Wi-Fi SSID"
    default ""
    help
        Wi-Fi network used by this example. Keep the default empty in source
        control and inject a private value through sdkconfig.local.defaults.

config ESP_IRIS_EXAMPLE_WIFI_PASSWORD
    string "Wi-Fi password"
    default ""
    help
        Password for the Wi-Fi network. An empty password selects an open
        network. Never commit real credentials.

endmenu
```
