## components/esp_iris/Kconfig
```kconfig
menu "ESP-Iris device link"

config ESP_IRIS_ENABLE
    bool "Enable ESP-Iris"
    default y

if ESP_IRIS_ENABLE

menu "Device transports"

config ESP_IRIS_TRANSPORT_USB
    bool "USB CDC0 (ESP-Iris binary protocol only)"
    depends on IDF_TARGET_ESP32S31
    depends on !BSP_USB_CONSOLE
    select TINYUSB_CDC_ENABLED
    help
        ESP-Iris owns TinyUSB and CDC0. stdout/stderr are carried inside the
        binary LOG channel; CDC is not a text console and DTR/RTS never enters
        ROM download mode.

config ESP_IRIS_TRANSPORT_USB_SERIAL_JTAG
    bool "USB Serial/JTAG serial channel (ESP-Iris binary protocol only)"
    depends on SOC_USB_SERIAL_JTAG_SUPPORTED
    depends on !ESP_CONSOLE_USB_SERIAL_JTAG
    depends on !ESP_CONSOLE_SECONDARY_USB_SERIAL_JTAG
    select USJ_ENABLE_USB_SERIAL_JTAG
    help
        ESP-Iris owns the fixed USB Serial/JTAG CDC serial channel. The JTAG
        interface remains available, but the serial channel cannot also be an
        ESP-IDF console or serial monitor. Flashing tools and ESP-Iris must not
        open the serial endpoint concurrently.

config ESP_IRIS_TRANSPORT_TCP
    bool "Raw TCP server"
    default y if !ESP_IRIS_TRANSPORT_USB && !ESP_IRIS_TRANSPORT_USB_SERIAL_JTAG
    help
        Listen on all device interfaces. ESP-Iris does not initialize Wi-Fi,
        provision credentials, or create a network interface.

comment "Select one or more transports; the first active client owns the session"
    help
        Enabled transports wait concurrently. A physical connection is only a
        provisional candidate. The first candidate to return a valid and, when
        configured, authenticated HELLO_ACK owns the session. Other transports
        are stopped after a winner is confirmed and restarted when that session
        disconnects.

endmenu

config ESP_IRIS_TRANSPORT_CLAIM_TIMEOUT_MS
    int "Provisional transport handshake timeout (ms)"
    range 250 10000
    default 2000
    help
        Maximum time a physical connection may wait for a valid HELLO_ACK when
        more than one transport is enabled. On timeout ESP-Iris releases that
        candidate and gives other connected transports a chance to negotiate.

config ESP_IRIS_TCP_PORT
    int "Raw TCP listen port"
    depends on ESP_IRIS_TRANSPORT_TCP
    range 1024 65535
    default 19772

config ESP_IRIS_USB_SERIAL_JTAG_RX_BUFFER_BYTES
    int "USB Serial/JTAG receive ring size"
    depends on ESP_IRIS_TRANSPORT_USB_SERIAL_JTAG
    range 512 8192
    default 2048

config ESP_IRIS_USB_SERIAL_JTAG_TX_BUFFER_BYTES
    int "USB Serial/JTAG transmit ring size"
    depends on ESP_IRIS_TRANSPORT_USB_SERIAL_JTAG
    range 512 8192
    default 2048

config ESP_IRIS_USB_SERIAL_JTAG_DISABLE_AUTO_RESET
    bool "Disable USB Serial/JTAG DTR/RTS reset while Iris is running"
    depends on ESP_IRIS_TRANSPORT_USB_SERIAL_JTAG
    default y
    help
        Prevent opening or closing the ESP-Iris serial endpoint from resetting
        the chip through the USB Serial/JTAG peripheral. The previous hardware
        setting is restored by esp_iris_stop(). Use a separate UART or manual
        boot/reset sequence when flashing while ESP-Iris is running.

config ESP_IRIS_TASK_STACK_SIZE
    int "Worker task stack size (bytes)"
    range 3072 8192
    default 3328

config ESP_IRIS_TASK_PRIORITY
    int "Worker task priority"
    range 1 20
    default 5

config ESP_IRIS_LOG_RING_BYTES
    int "stdout/stderr log ring size"
    range 2048 16384
    default 4096

config ESP_IRIS_CRASH_CHUNK_BYTES
    int "Maximum coredump bytes per response"
    range 256 2048
    default 1024
    help
        Bounds each read-only crash evidence response. The implementation
        reuses the receive frame buffer; no full coredump is allocated in RAM.

config ESP_IRIS_MAX_RPC_HANDLERS
    int "Maximum registered RPC handlers"
    range 1 32
    default 8

config ESP_IRIS_RPC_BODY_BYTES
    int "Maximum RPC request or response body"
    range 128 2048
    default 1024

config ESP_IRIS_MAX_JOBS
    int "Maximum retained jobs"
    range 1 16
    default 4

config ESP_IRIS_MEDIA_LATEST_BYTES
    int "Latest media chunk buffer per active channel"
    range 256 3840
    default 3840
    help
        Allocated only while mirror/IMAGE/AUDIO streaming is active. A newer
        submission replaces an unsent one and increments the drop count.

config ESP_IRIS_MAX_FILE_VOLUMES
    int "Maximum registered logical file volumes"
    range 1 8
    default 2

config ESP_IRIS_FILE_CHUNK_BYTES
    int "Maximum file data bytes per transfer frame"
    range 256 2048
    default 1024
    help
        Bounds the file task work/completion buffers and each stop-and-wait
        read or write.

config ESP_IRIS_FILE_TASK_STACK_SIZE
    int "File service task stack size (bytes)"
    range 3072 8192
    default 6144
    help
        Includes headroom for filesystem-specific directory and rename call
        chains in addition to the bounded ESP-Iris path buffers.

config ESP_IRIS_FILE_TASK_PRIORITY
    int "File service task priority"
    range 1 10
    default 3

config ESP_IRIS_OTA
    bool "Enable the bounded OTA image writer"
    default y
    help
        Enables the OTA channel that receives, validates and writes an image.
        Enable it in factory recovery firmware, or in a normal application
        that intentionally performs direct application-layer OTA. A normal
        application using recovery-assisted OTA may disable this option; it
        then needs only the product-specific enter-recovery control path.

        OTA is exposed only when an eligible non-running OTA partition exists.
        Factory, NVS, coredump and crash metadata partitions are never targets.

config ESP_IRIS_OTA_DEFAULT_VIA_RECOVERY
    bool "Use factory-recovery-assisted OTA for this normal application"
    default n
    help
        Declares the product policy for a normal application: the Gateway asks
        it to boot the fixed factory recovery image before transferring the
        update. The normal application can disable ESP_IRIS_OTA to omit the
        image writer, while still implementing RPC 0x7fff/2 to select and boot
        recovery. The recovery image itself must enable ESP_IRIS_OTA.

        The Gateway reports recovery entry, reconnect and transfer as one
        queryable operation. Select recovery execution on the Gateway as well;
        firmware configuration cannot silently change an explicit host request.

config ESP_IRIS_OTA_ALLOW_APPLICATION_FALLBACK
    bool "Allow fallback to application-layer OTA"
    depends on ESP_IRIS_OTA && ESP_IRIS_OTA_DEFAULT_VIA_RECOVERY
    default n
    help
        Keeps the OTA writer in a recovery-first normal application so a host
        may explicitly retry with application execution. The Gateway never
        falls back silently: failure to enter recovery fails that operation.

config ESP_IRIS_OTA_REQUIRE_PROJECT_NAME_MATCH
    bool "Require OTA project name to match the running firmware"
    default n
    help
        Rejects an OTA image when its esp_app_desc_t project_name differs
        from the project_name of the running firmware. The policy is
        advertised to the Gateway so recovery-first updates can be rejected
        before entering recovery when the normal firmware requires a match.

        Leave this disabled to allow intentional project renames and
        cross-project updates. Image integrity and the project/version
        metadata supplied with OTA are still validated independently.

config ESP_IRIS_OTA_CHUNK_BYTES
    int "Maximum OTA payload bytes per request"
    depends on ESP_IRIS_OTA
    range 256 3968
    default 1024
    help
        Number of image bytes in each OTA DATA request. The upper bound keeps
        an aligned data block plus its 4-byte offset within the protocol's
        4000-byte payload limit.

config ESP_IRIS_SYSTEM_INVENTORY
    bool "Expose read-only system Flash inventory"
    default n
    help
        Enables a small, read-only provider interface for reporting hashes of
        the actually installed bootloader and partition table plus the last
        committed system-update result. This can be enabled in normal and
        recovery firmware without exposing a Flash writer.

config ESP_IRIS_SYSTEM_UPDATE
    bool "Enable authenticated multi-image system update transport"
    select ESP_IRIS_SYSTEM_INVENTORY
    default n
    help
        Enables the protocol and product backend interface used to install a
        signed update plan containing application, bootloader, partition-table
        or product-defined data components. ESP-Iris itself never grants raw
        Flash access: a registered product backend must authenticate the
        manifest, authorize every descriptor and implement commit policy.

        Enable this only in a retained recovery image. Normal applications
        may enable ESP_IRIS_SYSTEM_INVENTORY for post-reboot verification and
        should otherwise expose only the enter-recovery control path.

config ESP_IRIS_SYSTEM_UPDATE_CHUNK_BYTES
    int "Maximum system-update data bytes per request"
    depends on ESP_IRIS_SYSTEM_UPDATE
    range 256 2048
    default 1024

config ESP_IRIS_SYSTEM_UPDATE_MANIFEST_BYTES
    int "Maximum authenticated system-update manifest size"
    depends on ESP_IRIS_SYSTEM_UPDATE
    range 256 3072
    default 2048

config ESP_IRIS_SYSTEM_UPDATE_SIGNATURE_BYTES
    int "Maximum system-update manifest signature size"
    depends on ESP_IRIS_SYSTEM_UPDATE
    range 64 512
    default 256

config ESP_IRIS_SYSTEM_UPDATE_MAX_COMPONENTS
    int "Maximum components in one system update"
    depends on ESP_IRIS_SYSTEM_UPDATE
    range 1 8
    default 4

config ESP_IRIS_TCP_PAIRING
    bool "Require challenge-HMAC pairing on raw TCP"
    depends on ESP_IRIS_TRANSPORT_TCP
    default n
    help
        Generates a random token in NVS. The token never crosses the device
        link; each session proves possession using a fresh challenge.

config ESP_IRIS_AUTH_FAILURE_DELAY_MS
    int "Minimum delay after a failed pairing proof"
    depends on ESP_IRIS_TCP_PAIRING
    range 100 5000
    default 500

config ESP_IRIS_USB_VID
    hex "USB vendor ID"
    depends on ESP_IRIS_TRANSPORT_USB
    range 0x0001 0xFFFF
    default 0x303A

config ESP_IRIS_USB_PID
    hex "USB product ID"
    depends on ESP_IRIS_TRANSPORT_USB
    range 0x0001 0xFFFF
    default 0x4002
    help
        0x4002 is suitable for development and matches Espressif TinyUSB CDC
        examples. Allocate a product PID before production distribution.

config ESP_IRIS_USB_MANUFACTURER
    string "USB manufacturer string"
    depends on ESP_IRIS_TRANSPORT_USB
    default "Espressif"

config ESP_IRIS_USB_PRODUCT
    string "USB product string"
    depends on ESP_IRIS_TRANSPORT_USB
    default "ESP-Iris"

endif

endmenu
```

## components/esp_iris/examples/crash_recovery/main/Kconfig.projbuild
```kconfig
menu "ESP-Iris crash/recovery example"

config ESP_IRIS_CRASH_EXAMPLE_RECOVERY
    bool "Build the factory recovery profile"
    default n

config ESP_IRIS_CRASH_EXAMPLE_AUTO_CRASH
    bool "Automatically inject startup crashes"
    depends on !ESP_IRIS_CRASH_EXAMPLE_RECOVERY
    default y

config ESP_IRIS_CRASH_EXAMPLE_CRASH_DELAY_MS
    int "Delay before an injected crash (ms)"
    depends on ESP_IRIS_CRASH_EXAMPLE_AUTO_CRASH
    range 500 60000
    default 3000

endmenu
```

## components/esp_iris/examples/lifecycle/main/Kconfig.projbuild
```kconfig
menu "ESP-Iris lifecycle example"

config ESP_IRIS_LIFECYCLE_EXAMPLE_RESTART_DELAY_MS
    int "Delay between stop and restart (ms)"
    range 250 10000
    default 2000

endmenu
```

## components/esp_iris/examples/media_streams/main/Kconfig.projbuild
```kconfig
menu "ESP-Iris media streams example"

choice ESP_IRIS_MEDIA_EXAMPLE_IMAGE_FORMAT
    prompt "Synthetic image format"
    default ESP_IRIS_MEDIA_EXAMPLE_RGB565

config ESP_IRIS_MEDIA_EXAMPLE_RGB565
    bool "RGB565"

config ESP_IRIS_MEDIA_EXAMPLE_RGB888
    bool "RGB888"

config ESP_IRIS_MEDIA_EXAMPLE_JPEG
    bool "Embedded JPEG"

config ESP_IRIS_MEDIA_EXAMPLE_PNG
    bool "Embedded PNG"

endchoice

endmenu
```

## components/esp_iris/examples/tcp_pairing/main/Kconfig.projbuild
```kconfig
menu "ESP-Iris TCP pairing example"

config ESP_IRIS_EXAMPLE_WIFI_SSID
    string "Wi-Fi SSID"
    default ""
    help
        Set only through an ignored sdkconfig.local.defaults file or
        menuconfig. The example never prints this value.

config ESP_IRIS_EXAMPLE_WIFI_PASSWORD
    string "Wi-Fi password"
    default ""
    help
        Set only through an ignored sdkconfig.local.defaults file or
        menuconfig. The example never prints this value.

config ESP_IRIS_EXAMPLE_PAIRING_TOKEN
    string "Initial 64-hex pairing token"
    default ""
    help
        Used only if no pairing token is already stored in NVS. The example
        never prints it. Generate a new 32-byte random value for every device.

endmenu
```

## components/esp_iris/test_apps/coredump/main/Kconfig.projbuild
```kconfig
menu "ESP-Iris private board-test settings"

config ESP_IRIS_TEST_WIFI_SSID
    string "Board-test Wi-Fi SSID"
    default ""

config ESP_IRIS_TEST_WIFI_PASSWORD
    string "Board-test Wi-Fi password"
    default ""

config ESP_IRIS_TEST_PAIRING_TOKEN
    string "Initial 64-hex pairing token"
    default ""

config ESP_IRIS_TEST_NEXT_PAIRING_TOKEN
    string "Rotated 64-hex pairing token"
    default ""

config ESP_IRIS_TEST_AUTO_MARK_HEALTHY
    bool "Automatically accept a pending OTA image"
    default y
    help
        Emit the ESP-Iris healthy lifecycle event after a normal pending OTA
        boot. Crash injection runs before this check, so an armed pending image
        still crashes and exercises bootloader rollback and coredump retention.

endmenu
```

## components/esp_iris/test_apps/coredump/sdkconfig.defaults
```kconfig
CONFIG_IDF_TARGET="esp32s31"
CONFIG_IDF_EXPERIMENTAL_FEATURES=y
CONFIG_COMPILER_OPTIMIZATION_PERF=y
CONFIG_ESPTOOLPY_FLASHSIZE_16MB=y
CONFIG_PARTITION_TABLE_CUSTOM=y
CONFIG_PARTITION_TABLE_CUSTOM_FILENAME="partitions.csv"
CONFIG_ESP_COREDUMP_ENABLE_TO_FLASH=y
CONFIG_APP_RETRIEVE_LEN_ELF_SHA=64
CONFIG_ESP_CONSOLE_USB_SERIAL_JTAG=y
CONFIG_ESP_CONSOLE_SECONDARY_NONE=y
CONFIG_ESP_IRIS_TRANSPORT_TCP=y
CONFIG_ESP_IRIS_TCP_PAIRING=y
CONFIG_BOOTLOADER_APP_ROLLBACK_ENABLE=y
CONFIG_SPI_FLASH_AUTO_SUSPEND=y
CONFIG_ESP_IRIS_TASK_STACK_SIZE=3328
```

## components/esp_iris/test_apps/disabled/sdkconfig.defaults
```kconfig
CONFIG_IDF_TARGET="esp32s31"
CONFIG_IDF_EXPERIMENTAL_FEATURES=y
# CONFIG_ESP_IRIS_ENABLE is not set
```

## components/esp_iris/test_apps/system_update/sdkconfig.defaults
```kconfig
CONFIG_IDF_TARGET="esp32s31"
CONFIG_IDF_EXPERIMENTAL_FEATURES=y
CONFIG_COMPILER_OPTIMIZATION_PERF=y
CONFIG_ESPTOOLPY_FLASHSIZE_2MB=y
CONFIG_ESP_IRIS_TRANSPORT_TCP=y
CONFIG_ESP_IRIS_SYSTEM_UPDATE=y
CONFIG_ESP_IRIS_SYSTEM_UPDATE_CHUNK_BYTES=1024
CONFIG_ESP_IRIS_SYSTEM_UPDATE_MANIFEST_BYTES=2048
CONFIG_ESP_IRIS_SYSTEM_UPDATE_SIGNATURE_BYTES=256
CONFIG_ESP_IRIS_SYSTEM_UPDATE_MAX_COMPONENTS=4
```
